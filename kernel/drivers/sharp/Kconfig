## kernel/drivers/sharp/Kconfig
```kconfig
#
# SHARP configuration
#

menu "SHARP Device Drivers"

source "drivers/sharp/shdiag/Kconfig"
source "drivers/sharp/shbatt/Kconfig"
#CONFIG_SH_AUDIO_DRIVER-> 08-007
source "drivers/sharp/shaudio/Kconfig"
#CONFIG_SH_AUDIO_DRIVER<- 08-007
source "drivers/sharp/shtimer/Kconfig"
source "drivers/sharp/shlog/Kconfig"
source "drivers/sharp/shcamled/Kconfig"
source "drivers/sharp/shtps/Kconfig"
source "drivers/sharp/shmds/Kconfig"
source "drivers/sharp/proximity/Kconfig"
source "drivers/sharp/vold/Kconfig"

source "drivers/sharp/shterm/Kconfig"
#Modify SHARP_EXTEND "Static link mod" 2014.02.25 Start
source "drivers/sharp/wifi/Kconfig"
#Modify SHARP_EXTEND "Static link mod" 2014.02.25 End
endmenu
```
